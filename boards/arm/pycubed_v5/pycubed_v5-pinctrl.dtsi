/*
 * Copyright (c) 2022, Gerson Fernando Budke <nandojve@gmail.com>
 * SPDX-License-Identifier: Apache-2.0
 */

#include <dt-bindings/pinctrl/same51j-pinctrl.h>

&pinctrl {
	// sercom2_spi_default: sercom2_spi_default {
	// 	group1 {
	// 		pinmux = <PA9D_SERCOM2_PAD0>,
	// 			 <P81D_SERCOM2_PAD1>,
	// 			 <PB11C_SERCOM2_PAD3>;
	// 	};
	// };

	// sercom5_uart_default: sercom5_uart_default {
	// 	group1 {
	// 		pinmux = <PB2D_SERCOM5_PAD0>,
	// 			 <PB3D_SERCOM5_PAD1>;
	// 	};
	// };

	usb_dc_default: usb_dc_default {
		group1 {
			pinmux = <PA25H_USB_DP>,
				 <PA24H_USB_DM>;
		};
	};
};
